/*
 * Copyright (c) 2022, Gerson Fernando Budke <nandojve@gmail.com>
 * SPDX-License-Identifier: Apache-2.0
 */

#include <dt-bindings/pinctrl/samd11d-pinctrl.h>

&pinctrl {
	// pwm_default: pwm_default {
	// 	group1 {
	// 		pinmux = <PB30E_TCC0_WO0>;
	// 	};
	// };

	// sercom2_i2c_default: sercom2_i2c_default {
	// 	group1 {
	// 		pinmux = <PA8D_SERCOM2_PAD0>,
	// 			 <PA9D_SERCOM2_PAD1>;
	// 	};
	// };

	// sercom0_uart_default: sercom0_uart_default {
	// 	group1 {
	// 		pinmux = <PA11C_SERCOM0_PAD3>,
	// 			 <PA10C_SERCOM0_PAD2>;
	// 	};
	// };
	// sercom1_uart_default: sercom1_uart_default {
	// 	group1 {
	// 		pinmux = <PA19C_SERCOM1_PAD3>,
	// 			 <PA16C_SERCOM1_PAD0>;
	// 	};
	// };
};
