## boards/atmel/sam0/samd11_xpro/Kconfig.samd11_xpro
```kconfig
# Copyright (c) 2018 Bryan O'Donoghue
# Copyright (c) 2024 Gerson Fernando Budke <nandojve@gmail.com>
# SPDX-License-Identifier: Apache-2.0

config BOARD_SAMD11_XPRO
	select SOC_SAMD11D14AM
```

## drivers/spi/Kconfig.mchp_v1
```kconfig
# Atmel MCHP V1 SERCOM SPI

# Copyright (c) 2017 Google LLC.
# SPDX-License-Identifier: Apache-2.0

config SPI_MCHP_V1
    bool "Microchip MCHP V1 series SERCOM SPI driver"
    default y
    depends on DT_HAS_MCHP_V1_SPI_ENABLED
    select DMA if SPI_ASYNC
    help
      Enable support for the Microchip MCHP V1 series SERCOM SPI driver.


menu "SPI ASYNC SELECTION"
  depends on SPI_MCHP_V1 && SPI_ASYNC

choice 
    prompt "Select Async Mode Interrupt or DMA"
    default SPI_MCHP_INTERRUPT_DRIVEN
    help
      Choose between interrupt-driven or DMA mode for the MCHP SPI driver.

    config SPI_MCHP_INTERRUPT_DRIVEN
    bool "Interrupt-Driven"
    help
      Enables interrupt support for MCHP SPI driver.

    config SPI_DMA_DRIVEN
    bool "DMA"
    help
      Enables DMA support for MCHP SPI driver.
endchoice
endmenu
```

## drivers/spi/Kconfig.microchip_v1
```kconfig
# MICROCHIP V1 SERCOM SPI

# Copyright (c) 2017 Google LLC.
# SPDX-License-Identifier: Apache-2.0

config SPI_MICROCHIP_V1
    bool "Microchip MICROCHIP V1 series SERCOM SPI driver"
    default y
    depends on DT_HAS_MICROCHIP_V1_SPI_ENABLED
    select DMA if SPI_ASYNC
    help
      Enable support for the Microchip MICROCHIP V1 series SERCOM SPI driver.

# DT_HAS_MICROCHIP_V1_SPI_ENABLED
```

## soc/atmel/sam0/samd11/Kconfig
```kconfig
config SOC_SERIES_SAMD11
	select ARM
	select CPU_CORTEX_M0PLUS
	select CPU_CORTEX_M_HAS_SYSTICK
	select CPU_CORTEX_M_HAS_VTOR
	select PLATFORM_SPECIFIC_INIT
```
